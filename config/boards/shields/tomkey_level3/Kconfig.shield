## config/boards/shields/tomkey_level3/Kconfig.shield
```kconfig
config SHIELD_TOMKEY_L3
    def_bool $(shields_list_contains,tomkey_L3)

config SHIELD_TOMKEY_R3
    def_bool $(shields_list_contains,tomkey_R3)
```
