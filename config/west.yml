## config/west.yml
```yaml
manifest:
  remotes:
    - name: cormoran
      url-base: https://github.com/cormoran
    - name: badjeff
      url-base: https://github.com/badjeff
    - name: te9no
      url-base: https://github.com/te9no
  projects:
    # ZMK: DYA Studio 用カスタム RPC サブシステム付き cormoran fork
    - name: zmk
      remote: cormoran
      revision: v0.3-branch+dya
      import: app/west.yml
    # DYA Studio モジュール
    - name: zmk-module-ble-management
      remote: cormoran
      revision: main
    - name: zmk-module-battery-history
      remote: cormoran
      revision: main
    - name: zmk-module-settings-rpc
      remote: cormoran
      revision: main
    - name: zmk-module-runtime-input-processor
      remote: cormoran
      revision: main
    # トラックボールドライバー (badjeff)
    - name: zmk-pmw3610-driver
      remote: badjeff
      revision: zmk-0.3
    # ドングルディスプレイ
    - name: zmk-dongle-display
      remote: te9no
      revision: main
  self:
    path: config
```

## old_KB-love/config/boards/shields/tomkey/Kconfig.defconfig
```kconfig
if SHIELD_TOMKEY_R

  config ZMK_KEYBOARD_NAME
      default "tomkey_R"

  config ZMK_SPLIT
      default y

endif

if SHIELD_TOMKEY_L

    config ZMK_KEYBOARD_NAME
        default "tomkey_L"

    config ZMK_SPLIT_ROLE_CENTRAL
        default y

    config ZMK_SPLIT
        default y

    if ZMK_DISPLAY
        config I2C
            default y

        config SSD1306
            default y
    endif # ZMK_DISPLAY

    if LVGL
        config LV_Z_VDB_SIZE
            default 64

        config LV_DPI_DEF
            default 148

        config LV_Z_BITS_PER_PIXEL
            default 1

        choice LV_COLOR_DEPTH
            default LV_COLOR_DEPTH_1
        endchoice
  endif # LVGL

endif
```

## old_KB-love/config/boards/shields/tomkey/Kconfig.shield
```kconfig
config SHIELD_TOMKEY_R
    def_bool $(shields_list_contains,tomkey_R)

config SHIELD_TOMKEY_L
    def_bool $(shields_list_contains,tomkey_L)
```
